## tests/unikraft/defconfig
```kconfig
# SPDX-License-Identifier: BSD-3-Clause
CONFIG_ARCH_X86_64=y
CONFIG_PLAT_KVM=y
CONFIG_KVM_VMM_QEMU=y
CONFIG_KVM_BOOT_PROTO_MULTIBOOT=y
CONFIG_UKPLAT_CPU_MAXCOUNT=1
CONFIG_LIBUKALLOCBBUDDY=y
CONFIG_LIBUKBOOT_INITBBUDDY=y
CONFIG_LIBUKINTCTLR_APIC=y
CONFIG_LIBMANA=y
CONFIG_LIBMANA_DIRECT_DMA=n
CONFIG_LIBVIRTIO_NET=n
CONFIG_LIBUKNETDEV_MAXNBQUEUES=1
```
